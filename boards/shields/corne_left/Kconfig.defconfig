## boards/shields/corne_left/Kconfig.defconfig
```kconfig
# Copyright (c) 2020 The ZMK Contributors
# SPDX-License-Identifier: MIT

if SHIELD_CORNE_LEFT

config ZMK_KEYBOARD_NAME
	default "Corne Left"

config ZMK_SPLIT_ROLE_CENTRAL
	bool
	default y

endif 
```

## boards/shields/corne_left/Kconfig.shield
```kconfig
# Copyright (c) 2020 The ZMK Contributors
# SPDX-License-Identifier: MIT

config SHIELD_CORNE_LEFT
	def_bool $(shields_list_contains,corne_left) 
```

## boards/shields/corne_right/Kconfig.defconfig
```kconfig
# Copyright (c) 2020 The ZMK Contributors
# SPDX-License-Identifier: MIT

if SHIELD_CORNE_RIGHT

config ZMK_KEYBOARD_NAME
	default "Corne Right"

config ZMK_SPLIT_ROLE_PERIPHERAL
	default y

endif 
```

## config/boards/shields/corne/Kconfig.defconfig
```kconfig
# Kconfig.defconfig for Corne split keyboard
if SHIELD_CORNE
config ZMK_KEYBOARD_NAME
    default "corne"
endif 
```

## config/boards/shields/corne/Kconfig.shield
```kconfig
# Kconfig.shield for Corne split keyboard
config SHIELD_CORNE
    bool "Corne Split Keyboard" 

CONFIG_ZMK_SPLIT=y
CONFIG_ZMK_BLE=y 
```

## config/boards/shields/scottochoczard/Kconfig.defconfig
```kconfig
if SHIELD_SCOTTOCHOCZARD_LEFT

config ZMK_KEYBOARD_NAME
    default "ScottoChoczard"

config ZMK_SPLIT_ROLE_CENTRAL
    bool
    default y

endif

if SHIELD_SCOTTOCHOCZARD_RIGHT

config ZMK_SPLIT_ROLE_PERIPHERAL
    bool
    default y

endif

if SHIELD_SCOTTOCHOCZARD_LEFT || SHIELD_SCOTTOCHOCZARD_RIGHT

config ZMK_SPLIT
    bool
    default y

endif
```
