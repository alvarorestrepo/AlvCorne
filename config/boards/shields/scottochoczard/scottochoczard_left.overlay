#include "scottochoczard.dtsi"

&kscan {
    col-gpios = <&pro_micro 22 GPIO_ACTIVE_HIGH>,
                <&pro_micro 24 GPIO_ACTIVE_HIGH>,
                <&pro_micro 32 GPIO_ACTIVE_HIGH>,
                <&pro_micro 11 GPIO_ACTIVE_HIGH>,
                <&pro_micro 36 GPIO_ACTIVE_HIGH>,
                <&pro_micro 38 GPIO_ACTIVE_HIGH>;
};